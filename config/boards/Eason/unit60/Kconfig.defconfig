## config/boards/Eason/unit60/Kconfig.defconfig
```kconfig
# Copyright (c) 2025 Eason
# SPDX-License-Identifier: MIT

if BOARD_UNIT60

config ZMK_KEYBOARD_NAME
	default "unit60"

if USB

config USB_NRFX
	default y

config USB_DEVICE_STACK
	default y

config USB_DEVICE_MANUFACTURER
	default "Eason"

endif # USB

if BT

config BT_DIS_MANUF
	default "Eason"

config BT_DIS_MODEL
	default "unit60"

endif # BT

config BT_CTLR
	default BT

config ZMK_BLE
	default y

config ZMK_USB
	default y

if ZMK_RGB_UNDERGLOW

config ZMK_RGB_UNDERGLOW_HUE_START
	default 0

config ZMK_RGB_UNDERGLOW_EFF_START
	default 0

endif # ZMK_RGB_UNDERGLOW

endif # BOARD_UNIT60
```

## config/boards/Eason/unit60/Kconfig.unit60
```kconfig
# unit60 board configuration

# Copyright (c) 2025 Eason
# SPDX-License-Identifier: MIT

config BOARD_UNIT60
    select SOC_NRF52840_QIAA
    imply RETAINED_MEM
    imply RETENTION
    imply RETENTION_BOOT_MODE

# 本地 rgbled_widget 配置选项（已适配 ph-design/zmks 分支）
rsource "rgbled_widget/Kconfig"
```
